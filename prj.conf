## prj.conf
```kconfig
#
# Copyright (c) 2023 I-Sensi
#

# Use GPIOs
CONFIG_GPIO=y

# Logging config
CONFIG_LOG=n

# Debugging hardware
CONFIG_HWINFO=y
CONFIG_HWINFO_LOG_LEVEL_DBG=y

# Desativa debug UART
CONFIG_UART_CONSOLE=n

# Use RTT config
CONFIG_USE_SEGGER_RTT=y
CONFIG_RTT_CONSOLE=y
CONFIG_LOG_MODE_IMMEDIATE=y
CONFIG_PRINTK=y
CONFIG_STDOUT_CONSOLE=y

# Serial config
CONFIG_SERIAL=n

# use floating point
CONFIG_FPU=y
CONFIG_CBPRINTF_FP_SUPPORT=y

# Olds
CONFIG_NEWLIB_LIBC=y

# Logging configs
CONFIG_LOG_MODE_OVERFLOW=y
CONFIG_LOG_BUFFER_SIZE=2048

CONFIG_GPIO_AS_PINRESET=y
CONFIG_NFCT_PINS_AS_GPIOS=y

CONFIG_CLOCK_CONTROL_NRF_K32SRC_XTAL=n
CONFIG_CLOCK_CONTROL_NRF_K32SRC_50PPM=n
```

## boards/nrf52833dk_nrf52833.overlay
```dts
// / {
    //     // zephyr,user {
        //         //     io-channels = <&adc 2>, <&adc 3>;
    //     // };

    //     aliases {
        //         // d-out-p003 = &d_out_p003;
        //         // d-out-p109 = &d_out_p109;
        //         d-out-p010 = &d_out_p010;
        //         // d-out-p030 = &d_out_p030;

        //         // d-in-p009 = &d_in_p009;
        //         // d-in-p011 = &d_in_p011;
        //         // d-in-p018 = &d_in_p018;
        //         // d-in-p020 = &d_in_p020;
        //         // d-in-p031 = &d_in_p031;

        //         // i2c-0 = &i2c0;
        //         // spi-0 = &spi1;
    //     };

    //     user-gpio-output {
        //         compatible = "gpio-leds";
        //         // d_out_p003: out_p003 {
            //             //     gpios = <&gpio0 0x03 GPIO_ACTIVE_LOW>;
            //             //     label = "CS eeprom";
        //         // };
        //         // d_out_p109: out_p109 {
            //             //     gpios = <&gpio1 9 (GPIO_ACTIVE_LOW)>;
            //             //     label = "Load switch";
        //         // };
        //         d_out_p010: out_p010 {
            //             gpios = <&gpio0 0x0a GPIO_ACTIVE_LOW>;
            //             label = "Led 0";
        //         };
        //         // d_out_p030: out_p030 {
            //             //     gpios = <&gpio0 0x1e GPIO_ACTIVE_LOW>;
            //             //     label = "CS sensor";
        //         // };
    //     };

    //     // user-gpio-input{
        //         //     compatible = "gpio-keys";
        //         //     d_in_p009: in_p009 {
            //             //         gpios = <&gpio0 0x09 (GPIO_ACTIVE_LOW | GPIO_PULL_UP)>;
            //             //         label = "Hall sensor";
        //         //     };
        //         //     d_in_p011: in_p011 {
            //             //         gpios = <&gpio0 0x0b (GPIO_ACTIVE_LOW | GPIO_PULL_UP)>;
            //             //         label = "Digital pin";
        //         //     };
        //         //     d_in_p018: in_p018 {
            //             //         gpios = <&gpio0 18 (GPIO_ACTIVE_LOW)>;
            //             //         label = "Sw0";
        //         //     };
        //         //     d_in_p020: in_p020 {
            //             //         gpios = <&gpio0 0x14 (GPIO_ACTIVE_LOW | GPIO_PULL_UP)>;
            //             //         label = "Int TOF";
        //         //     };
        //         //     d_in_p031: in_p031 {
            //             //         gpios = <&gpio0 0x1F (GPIO_ACTIVE_LOW | GPIO_PULL_UP)>;
            //             //         label = "Int ACC";
        //         //     };
    //     // };
// };
// //     soc {
    //     //         i2c0: i2c@40003000 {
        //         //             compatible = "nordic,nrf-twi";
        //         //             #address-cells = <0x1>;
        //         //             #size-cells = <0x0>;
        //         //             reg = <0x40003000 0x1000>;
        //         //             clock-frequency = <0x186a0>;
        //         //             interrupts = <0x3 0x1>;
        //         //             status = "okay";
        //         //             pinctrl-0 = <&i2c0_default>;
        //         //             pinctrl-1 = <&i2c0_sleep>;
        //         //             pinctrl-names = "default", "sleep";
    //     //         };
    //     //         spi1: spi@40004000 {
        //         //             compatible = "nordic,nrf-spi";
        //         //             #address-cells = <0x1>;
        //         //             #size-cells = <0x0>;
        //         //             reg = <0x40004000 0x1000>;
        //         //             interrupts = <0x4 0x1>;
        //         //             max-frequency = <0x7a1200>;
        //         //             status = "okay";
        //         //             pinctrl-0 = <&spi1_default>;
        //         //             pinctrl-1 = <&spi1_sleep>;
        //         //             pinctrl-names = "default", "sleep";
        //         //             cs-gpios = <&gpio0 30 GPIO_ACTIVE_LOW>;
    //     //         };
// //     };
// // };

// // &adc {
    //     //     #address-cells = <1>;
    //     //     #size-cells = <0>;

    //     //     channel@2 {
        //         //         reg = <2>;
        //         //         zephyr,gain = "ADC_GAIN_1_6";
        //         //         zephyr,reference = "ADC_REF_INTERNAL";
        //         //         zephyr,acquisition-time = <ADC_ACQ_TIME(ADC_ACQ_TIME_MICROSECONDS, 20)>;
        //         //         zephyr,input-positive = <NRF_SAADC_AIN2>;
    //     //     };
    //     //     channel@3 {
        //         //         reg = <3>;
        //         //         zephyr,gain = "ADC_GAIN_1_6";
        //         //         zephyr,reference = "ADC_REF_INTERNAL";
        //         //         zephyr,acquisition-time = <ADC_ACQ_TIME(ADC_ACQ_TIME_MICROSECONDS, 20)>;
        //         //         zephyr,input-positive = <NRF_SAADC_AIN3>;
    //     //     };
// // };

// // &pinctrl {
    //     //     i2c0_default: i2c0_default {
        //         //         phandle = <0x4>;
        //         //         group1 {
            //             //             psels = <NRF_PSEL(TWIM_SCL, 0, 15)>, <NRF_PSEL(TWIM_SDA, 0, 17)>;
        //         //         };
    //     //     };
    //     //     i2c0_sleep: i2c0_sleep {
        //         //         phandle = <0x5>;
        //         //         group1 {
            //             //             psels = <NRF_PSEL(TWIM_SCL, 0, 15)>, <NRF_PSEL(TWIM_SDA, 0, 17)>;
            //             //             low-power-enable;
        //         //         };
    //     //     };

    //     //     spi1_default: spi1_default {
        //         //         phandle = <0xa>;
        //         //         group1 {
            //             //             psels = <0x4001d>, <0x5001c>, <0x60002>;
        //         //         };
    //     //     };
    //     //     spi1_sleep: spi1_sleep {
        //         //         phandle = <0xb>;
        //         //         group1 {
            //             //             psels = <0x4001d>, <0x5001c>, <0x60002>;
            //             //             low-power-enable;
        //         //         };
    //     //     };
// // };
// &led1 {
    //     gpios = <&gpio0 10 (GPIO_ACTIVE_LOW)>;
// };

&led1 {
    gpios = <&gpio0 10 (GPIO_ACTIVE_LOW)>;
};

&led1 {
    gpios = <&gpio0 20 (GPIO_ACTIVE_LOW)>;
};

&led1 {
    gpios = <&gpio0 10 (GPIO_ACTIVE_LOW)>;
};

&led1 {
    gpios = <&gpio1 9 (GPIO_ACTIVE_LOW)>;
};

&led1 {
    gpios = <&gpio0 10 (GPIO_ACTIVE_LOW)>;
};
```

## src/main.c
```c
/*
 * Copyright (c) 2016 Intel Corporation
 *
 * SPDX-License-Identifier: Apache-2.0
 */

#include <zephyr/kernel.h>
#include <zephyr/drivers/gpio.h>

/* 1000 msec = 1 sec */
#define SLEEP_TIME_MS 500

/* The devicetree node identifier for the "led0" alias. */
#define LED0_NODE DT_ALIAS(led1)

/*
 * A build error on this line means your board is unsupported.
 * See the sample documentation for information on how to fix this.
 */
static const struct gpio_dt_spec led = GPIO_DT_SPEC_GET(LED0_NODE, gpios);

void main(void)
{
	int ret;
	printk("Teste magneto pisca led...123\n");

	if (!device_is_ready(led.port))
	{
		return;
	}

	ret = gpio_pin_configure_dt(&led, GPIO_OUTPUT_ACTIVE);
	if (ret < 0)
	{
		return;
	}

	while (1)
	{
		ret = gpio_pin_toggle_dt(&led);
		if (ret < 0)
		{
			return;
		}
		k_msleep(SLEEP_TIME_MS);
	}
}
```
